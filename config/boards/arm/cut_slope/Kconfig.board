## config/boards/arm/cut_slope/Kconfig.board
```kconfig
# Copyright (c) 2023 The ZMK Contributors
# SPDX-License-Identifier: Apache-2.0

config BOARD_CUT_SLOPE
    bool "Cut Slope"
    depends on SOC_RP2040
```

## config/boards/arm/cut_slope/Kconfig.defconfig
```kconfig
# Copyright (c) 2023 The ZMK Contributors
# SPDX-License-Identifier: MIT

if BOARD_CUT_SLOPE

config ZMK_KEYBOARD_NAME
    default "Cut Slope"

config RP2_FLASH_W25Q080
    default y

config ZMK_USB
    default y

endif # BOARD_CUT_SLOPE
```
